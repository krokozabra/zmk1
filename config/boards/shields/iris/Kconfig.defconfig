## config/boards/shields/iris/Kconfig.defconfig
```kconfig
# Левая половина - центральная
if SHIELD_IRIS_LEFT_CENTRAL
config ZMK_SPLIT_BLE_ROLE_CENTRAL
    default y
config ZMK_USB
    default y
config ZMK_BLE
    default y
config BT
    default y
config ZMK_KEYBOARD_NAME
    default "Igris"
endif

# Правая половина - периферийная
if SHIELD_IRIS_RIGHT_PERIPHERAL
config ZMK_SPLIT_BLE_ROLE_CENTRAL
    default n
config ZMK_USB
    default n  # ← USB отключаем для периферийной
config ZMK_KEYBOARD_NAME
    default "Igris_RIGHT"
endif

# Общие настройки для обеих половинок
if SHIELD_IRIS_LEFT_CENTRAL || SHIELD_IRIS_RIGHT_PERIPHERAL
config ZMK_SPLIT
    default y
endif
```

## config/boards/shields/iris/Kconfig.shield
```kconfig
config SHIELD_IRIS_LEFT_CENTRAL
	def_bool $(shields_list_contains,iris_left_central)

config SHIELD_IRIS_RIGHT_PERIPHERAL
	def_bool $(shields_list_contains,iris_right_peripheral)
```
